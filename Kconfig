## Kconfig
```kconfig
# Copyright (c) 2026 Spencer Deven (@Aleblazer)
# SPDX-License-Identifier: MIT

menuconfig ZMK_VOXEL_DISPLAY
    bool "Volumetric SH1107 OLED display (stacked panels, one or more SPI buses)"
    default y
    depends on DT_HAS_ALEBLAZER_VOXEL_SH1107_ENABLED
    select SPI
    select GPIO
    help
      Drives a stack of SH1107 128x128 OLED panels as a 128x128xN voxel
      volume. Panels are grouped into banks; each bank is an SPI device node
      with its own chip-select list, and banks transfer in parallel.

if ZMK_VOXEL_DISPLAY

config ZMK_VOXEL_BANK_THREAD_STACK_SIZE
    int "Stack size of each bank transfer thread"
    default 1024

config ZMK_VOXEL_FRAME_THREAD_STACK_SIZE
    int "Stack size of the frame scheduler thread"
    default 1024

config ZMK_VOXEL_THREAD_PRIORITY
    int "Priority of the transfer threads (preemptible)"
    default 10
    help
      Kept below the Bluetooth and USB threads so display traffic never
      delays HID reports.

config ZMK_VOXEL_BLANK_ON_IDLE
    bool "Blank the volume when ZMK reports idle, wake it on activity"
    default y
    help
      Uses the global ZMK idle timeout (CONFIG_ZMK_IDLE_TIMEOUT).

config ZMK_VOXEL_ANIM
    bool "Built-in test animations"
    default y
    help
      Keypress glyphs flying rear to front, a retro parallax scene and a
      bouncing block, selectable at runtime with the &voxel behavior.

if ZMK_VOXEL_ANIM

config ZMK_VOXEL_ANIM_THREAD_STACK_SIZE
    int "Stack size of the animation thread"
    default 2048

config ZMK_VOXEL_ANIM_FRAME_MS
    int "Animation drawing interval in milliseconds"
    default 33

config ZMK_VOXEL_ANIM_DEFAULT
    int "Animation at boot (0 off, 1 keyfall, 2 parallax, 3 bounce)"
    default 1
    range 0 3

config ZMK_VOXEL_KEYFALL_MAX
    int "Maximum glyphs in flight"
    default 24

endif # ZMK_VOXEL_ANIM

config ZMK_VOXEL_BEHAVIOR
    bool "&voxel keymap behavior"
    default y
    depends on DT_HAS_ALEBLAZER_BEHAVIOR_VOXEL_ENABLED

module = ZMK_VOXEL
module-str = zmk_voxel
source "subsys/logging/Kconfig.template.log_config"

endif # ZMK_VOXEL_DISPLAY
```

## boards/shields/voxel_volume/Kconfig.defconfig
```kconfig
if SHIELD_VOXEL_VOLUME

config SPI
    default y

config GPIO
    default y

config ZMK_VOXEL_DISPLAY
    default y

endif
```

## dts/bindings/behaviors/aleblazer,behavior-voxel.yaml
```yaml
# Copyright (c) 2026 Spencer Deven (@Aleblazer)
# SPDX-License-Identifier: MIT

description: |
  Controls the volumetric display. Parameter is one of the VX_* commands
  from dt-bindings/zmk_voxel/voxel.h.

compatible: "aleblazer,behavior-voxel"

include: one_param.yaml
```

## dts/bindings/display/aleblazer,voxel-sh1107-bank.yaml
```yaml
# Copyright (c) 2026 Spencer Deven (@Aleblazer)
# SPDX-License-Identifier: MIT

description: |
  One group of SH1107 panels sharing an SPI bus. Must be a child of an SPI
  controller. The controller's cs-gpios are not used; every panel's chip
  select is listed in panel-cs-gpios and driven by the driver, which also
  asserts them all at once to broadcast commands.

  D/C and RESET may be shared between banks (the driver keeps every bank in
  the same phase, commands or data, at any moment).

compatible: "aleblazer,voxel-sh1107-bank"

include: spi-device.yaml

properties:
  panel-cs-gpios:
    type: phandle-array
    required: true
    description: Chip select of each panel in this bank, in z order.

  dc-gpios:
    type: phandle-array
    required: true
    description: Data/command (A0) line of the panels in this bank.

  reset-gpios:
    type: phandle-array
    description: RES line of the panels in this bank.
```

## dts/bindings/display/aleblazer,voxel-sh1107.yaml
```yaml
# Copyright (c) 2026 Spencer Deven (@Aleblazer)
# SPDX-License-Identifier: MIT

description: |
  Volumetric display made of stacked SH1107 128x128 OLED panels. The panels
  are grouped into banks (see aleblazer,voxel-sh1107-bank); banks sit on
  separate SPI buses and are refreshed in parallel. Layer z = 0 is the first
  panel of the first bank and counts up through each bank's panel-cs-gpios
  list in order.

compatible: "aleblazer,voxel-sh1107"

properties:
  banks:
    type: phandles
    required: true
    description: Bank nodes in z order, front-most first.

  vpp-en-gpios:
    type: phandle-array
    description: |
      Optional enable line for the external panel supply (VPP, 7-16.5 V,
      13.5 V nominal). Driven active while the display is on so the SH1107
      power sequence is honoured. Omit if the supply is always on.

  contrast:
    type: int
    default: 162
    description: SH1107 contrast register (0xA2 is the panel spec at 13.5 V).

  flip-x:
    type: boolean
    description: SH1107 segment remap (mirrors x on every panel).

  flip-y:
    type: boolean
    description: Reverse COM scan direction (mirrors y on every panel).

  flip-z:
    type: boolean
    description: Reverse the layer order (front becomes rear).

  swap-xy:
    type: boolean
    description: Transpose x and y in software.
```
